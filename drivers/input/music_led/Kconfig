## drivers/input/music_led/Kconfig
```kconfig
#
# Touchscreen driver configuration
#
menuconfig MUSIC_LED
	bool "music_led"
	help
	  Say Y here, and a list of supported music_led will be displayed.
	  This option doesn't affect the kernel.

	  If unsure, say Y.

if MUSIC_LED

config SN3199
	tristate "sn3199"
	default n	
	help
	    say Y here if you have a sn3199 interface .  
	    
endif
```

## drivers/input/nfc/Kconfig
```kconfig
#
# Touchscreen driver configuration
#
menuconfig NFC
	bool "nfc"
	help
	  Say Y here, and a list of supported NFC will be displayed.
	  This option doesn't affect the kernel.

	  If unsure, say Y.

if NFC

config NFC_PN548
	tristate "nfc_pn_548"
	default n	
	help
	    say Y here if you have a NFC_PN548 interface .  
	    
	    

config NFC_MF175X
	tristate "NFC_MF175X"
	default n	
	help
	    say Y here if you have a NFC_MF175X interface .  


endif
```
